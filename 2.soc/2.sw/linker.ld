INCLUDE generated/output_format.ld
ENTRY(_start)

__DYNAMIC = 0;

INCLUDE generated/regions.ld

SECTIONS
{
	.text :
	{
		_ftext = .;
		/* Make sure crt0 files come first, and they, and the isr */
		/* don't get disposed of by greedy optimisation */
		*crt0*(.text)
		KEEP(*crt0*(.text))
		KEEP(*(.text.isr))

		*(.text .stub .text.* .gnu.linkonce.t.*)
		_etext = .;
	} > main_ram

	.rodata :
	{
		. = ALIGN(8);
		_frodata = .;
		*(.rodata .rodata.* .gnu.linkonce.r.*)
		*(.rodata1)
		*(.got .got.*)
		*(.toc .toc.*)
		. = ALIGN(8);
		_erodata = .;
	} > main_ram

	.data :
	{
		. = ALIGN(8);
		_fdata = .;
		*(.data .data.* .gnu.linkonce.d.*)
		*(.data1)
		_gp = ALIGN(16);
		*(.sdata .sdata.* .gnu.linkonce.s.*)
		. = ALIGN(8);
		_edata = .;
	} > data_ram AT > main_ram

	.bss :
	{
		. = ALIGN(8);
		_fbss = .;
		*(.dynsbss)
		*(.sbss .sbss.* .gnu.linkonce.sb.*)
		*(.scommon)
		*(.dynbss)
		*(.bss .bss.* .gnu.linkonce.b.*)
		*(COMMON)
		. = ALIGN(8);
		_ebss = .;
		_end = .;
	} > data_ram
}

PROVIDE(_fstack = ORIGIN(data_ram) + LENGTH(data_ram));
PROVIDE(__stack = _fstack);
PROVIDE(__heap_start = _end);
PROVIDE(__heap_end = __stack - (DEFINED(__stack_size) ? __stack_size : 0x800));
PROVIDE(__heap_size = __heap_end - __heap_start);

/* _fdata may follow leading alignment padding inside .data. crt0 copies
 * [_fdata, _edata), so the source must include the same offset. Without it,
 * a RAM-loaded image can copy forward over itself and corrupt initializers. */
PROVIDE(_fdata_rom = LOADADDR(.data) + (_fdata - ADDR(.data)));
PROVIDE(_edata_rom = _fdata_rom + (_edata - _fdata));
